## Firmware_LCLP/LCLP_Board/boards/LCLPGroup/LCLPv4/board.yml
```yaml
board:
  name: LCLPv4
  vendor: LCLPGroup
  socs:
  - name: nrf54l15
    variants:
    - name: xip
      cpucluster: cpuflpr
```

## Firmware_LCLP/LCLP_Code/build/Kconfig/boards/Kconfig.sysbuild
```kconfig
# Load Sysbuild board Kconfig descriptions.
osource "C:/Nordic/LCLP_Board/boards/LCLPGroup/LCLPv4/Kconfig.sysbuild"
```

## Firmware_LCLP/LCLP_Code/build/LCLP_Code/Kconfig/Kconfig.shield
```kconfig
osource "C:/Nordic/LCLP_Board/boards/shields/*/Kconfig.shield"
osource "C:/ncs/v3.1.1/nrf/boards/shields/*/Kconfig.shield"
```

## Firmware_LCLP/LCLP_Code/build/LCLP_Code/Kconfig/Kconfig.shield.defconfig
```kconfig
osource "C:/Nordic/LCLP_Board/boards/shields/*/Kconfig.defconfig"
osource "C:/ncs/v3.1.1/nrf/boards/shields/*/Kconfig.defconfig"
```

## Firmware_LCLP/LCLP_Code/build/LCLP_Code/Kconfig/boards/Kconfig
```kconfig
# Load Zephyr board Kconfig descriptions.
osource "C:/Nordic/LCLP_Board/boards/LCLPGroup/LCLPv4/Kconfig"
```

## Firmware_LCLP/LCLP_Code/build/LCLP_Code/Kconfig/boards/Kconfig.defconfig
```kconfig
# Load Zephyr board defconfig descriptions.
osource "C:/Nordic/LCLP_Board/boards/LCLPGroup/LCLPv4/Kconfig.defconfig"
```
